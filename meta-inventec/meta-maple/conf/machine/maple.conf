## meta-inventec/meta-maple/conf/machine/maple.conf
```bitbake
KMACHINE = "aspeed"

# The device tree is not ready yet, temporarily replace it with aspeed-ast2500-evb.dtb
KERNEL_DEVICETREE = "${KMACHINE}-ast2500-evb.dtb"
#KERNEL_DEVICETREE = "${KMACHINE}-bmc-inventec-${MACHINE}.dtb"

UBOOT_MACHINE = "ast_g5_ncsi_config"

FLASH_SIZE = "65536"

require conf/machine/include/ast2500.inc
require conf/machine/include/obmc-bsp-common.inc
```
